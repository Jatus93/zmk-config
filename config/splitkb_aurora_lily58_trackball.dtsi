/*
 * Shared trackball nodes for both Aurora Lily58 halves.
 *
 * The PIM447 sits on the right (peripheral) half. Its events are forwarded
 * over the split link through `trackball_split` and raised on the left
 * (central) half, where `trackball_listener` turns them into HID mouse reports.
 *
 * Both halves include this file so the keymap can reference
 * `&trackball_listener` (e.g. to add input processors) on either build.
 */

/ {
    split_inputs {
        #address-cells = <1>;
        #size-cells = <0>;

        /* Proxy device: sender on the peripheral, input source on the central. */
        trackball_split: trackball_split@0 {
            compatible = "zmk,input-split";
            reg = <0>;
        };
    };

    /* Disabled by default; enabled only on the central (left) half. */
    trackball_listener: trackball_listener {
        compatible = "zmk,input-listener";
        status = "disabled";
        device = <&trackball_split>;
    };
};
