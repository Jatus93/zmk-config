/*
 * Right (peripheral) half: Pimoroni PIM447 trackball on the OLED header I2C bus
 * (SDA = D2 / P0.17, SCL = D3 / P0.20), default address 0x0A.
 */

#include "splitkb_aurora_lily58_trackball.dtsi"

&pro_micro_i2c {
    status = "okay";

    pim447: trackball@a {
        compatible = "pimoroni,pim447";
        reg = <0xa>;
        status = "okay";

        /*
         * Polling mode (no extra wiring). For interrupt mode, which is better for
         * battery and lets the ball wake the half from deep sleep, wire the PIM447
         * INT pad to the "A" pad of any unused right-half encoder footprint
         * (ENC1_A, pro_micro 18), then uncomment the line below together with the
         * `&right_encoder` block at the end of this file.
         * Avoid D0/D1: D0 is the TRRS DATA line, D1 drives the RGB underglow.
         */
        poll-interval-ms = <15>;
        /* int-gpios = <&pro_micro 18 (GPIO_ACTIVE_LOW | GPIO_PULL_UP)>; */

        /* Pointer speed in 1/16ths: 16 = 1x, 48 = 3x. */
        base-scale = <48>;

        /* Adjust to match how the breakout is mounted. */
        swap-xy;
        /* invert-x; */
        /* invert-y; */
    };
};

&trackball_split {
    device = <&pim447>;
};

/* Uncomment when INT uses the encoder pin, so the encoder never claims it. */
/*
&right_encoder {
    status = "disabled";
};
*/
